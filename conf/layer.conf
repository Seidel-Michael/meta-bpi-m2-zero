## conf/layer.conf
```bitbake
# We have a conf and classes directory, append to BBPATH
BBPATH .= ":${LAYERDIR}"

# We have a recipes directory, add to BBFILES
BBFILES += "${LAYERDIR}/recipes*/*/*.bb ${LAYERDIR}/recipes*/*/*.bbappend"

BBFILE_COLLECTIONS += "meta-bpi-m2-zero"
BBFILE_PATTERN_meta-bpi-m2-zero := "^${LAYERDIR}/"
BBFILE_PRIORITY_meta-bpi-m2-zero = "10"

# This should only be incremented on significant changes that will
# cause compatibility issues with other layers
LAYERVERSION_meta-bpi-m2-zero = "1"

LAYERDEPENDS_meta-bpi-m2-zero = "core meta-sunxi"

LAYERSERIES_COMPAT_meta-bpi-m2-zero = "dunfell"
```
